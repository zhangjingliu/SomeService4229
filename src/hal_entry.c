#include "hal_data.h"
#include "bsp_debug_uart.h"
#include "bsp_canfd1.h"
#include "bsp_canfd0.h"
#include "Systick.h"

#include "CANFD_A2B.h"

#include "AB_Swap_Config.h"
#include "AB_Swap.h"
#include "UDS.h"
#include "uds_user.h"


extern volatile bool uart_send_complete_flag;

/* 外部变量和函数声明 */
extern volatile bool canfd0_rx_complete_flag;
extern can_frame_t canfd0_tx_frame;
extern can_frame_t canfd0_rx_frame;

//CAN
extern volatile bool canfd1_rx_complete_flag;
extern can_frame_t canfd1_rx_frame;
extern can_frame_t canfd1_tx_frame;


FSP_CPP_HEADER
void R_BSP_WarmStart(bsp_warm_start_event_t event);
FSP_CPP_FOOTER


static const uint8_t  txData[10] = {0x11, 0x22, 0x33, 0x44, 0x55, 0x66, 0x70, 0x80,0xff,0xaa};

static uint8_t DataBuf0[64] = {
  1,  2,  3,  4,  5,  6,  7,  8,  9,  10, 11, 12, 13, 14, 15, 16, 17, 18, 19, 20, 21, 22,
  23, 24, 25, 26, 27, 28, 29, 30, 31, 32, 33, 34, 35, 36, 37, 38, 39, 40, 41, 42, 43, 44,
  45, 46, 47, 48, 49, 50, 51, 52, 53, 54, 55, 56, 57, 58, 59, 60, 61, 62, 63, 64};

static uint8_t DataBuf1[64] = {
  1,  2,  3,  4,  5,  6,  7,  8,  9,  10, 11, 12, 13, 14, 15, 16, 17, 18, 19, 20, 21, 22,
  23, 24, 25, 26, 27, 28, 29, 30, 31, 32, 33, 34, 35, 36, 37, 38, 39, 40, 41, 42, 43, 44,
  45, 46, 47, 48, 49, 50, 51, 52, 53, 54, 55, 56, 57, 58, 59, 60, 61, 62, 63, 64};

/*******************************************************************************************************************//**
 * main() is generated by the RA Configuration editor and is used to generate threads if an RTOS is used.  This function
 * is called by main() when no RTOS is used.
 **********************************************************************************************************************/
void hal_entry(void)
{
    /* TODO: add your own code here */
	Debug_UART9_Init();
	hal_systick_init();
	CANFD1_Init();
	UDSInit();

	printf("RA8D1 UDS诊断测试开始\r\n");

    while(1)
    {
		//HAL_Delay(500);
		//CAN1_SendMessage(0x666, DataBuf0, 8);
		//CANFD1_SendMessage(0x777, DataBuf0,64);

       if(g_1ms_Falg == 1)
       	{
		  g_1ms_Falg = 0;
		  UDS();
	   }

#if 1		
		if (true == canfd1_rx_complete_flag)
		{
			canfd1_rx_complete_flag = false;
			TpFunc_Recv_Handle(canfd1_rx_frame.id, canfd1_rx_frame.data, canfd1_rx_frame.data_length_code);

			printf("Canfd6 Last Receive Pdu: \r\n");
			printf("ID: 0x%08x \r\n", canfd1_rx_frame.id);
			printf("DataLength: %d \r\n", canfd1_rx_frame.data_length_code);
			printf("Data: \r\n");
			for (uint32_t i = 1; i <= canfd1_rx_frame.data_length_code; i++)
			{
				printf("%d	", canfd1_rx_frame.data[i - 1]);
				if (i % 8 == 0)
				{
					printf("\r\n");
				}
				else
				{
				}
			}
			printf("\r\n");
		}
#endif


	}

#if BSP_TZ_SECURE_BUILD
    /* Enter non-secure code */
    R_BSP_NonSecureEnter();
#endif
}

/*******************************************************************************************************************//**
 * This function is called at various points during the startup process.  This implementation uses the event that is
 * called right before main() to set up the pins.
 *
 * @param[in]  event    Where at in the start up process the code is currently at
 **********************************************************************************************************************/
void R_BSP_WarmStart (bsp_warm_start_event_t event)
{
    if (BSP_WARM_START_RESET == event)
    {
#if BSP_FEATURE_FLASH_LP_VERSION != 0

        /* Enable reading from data flash. */
        R_FACI_LP->DFLCTL = 1U;

        /* Would normally have to wait tDSTOP(6us) for data flash recovery. Placing the enable here, before clock and
         * C runtime initialization, should negate the need for a delay since the initialization will typically take more than 6us. */
#endif
    }

    if (BSP_WARM_START_POST_C == event)
    {
        /* C runtime environment and system clocks are setup. */

        /* Configure pins. */
        R_IOPORT_Open(&g_ioport_ctrl, &IOPORT_CFG_NAME);
    }
}

#if BSP_TZ_SECURE_BUILD

FSP_CPP_HEADER
BSP_CMSE_NONSECURE_ENTRY void template_nonsecure_callable ();

/* Trustzone Secure Projects require at least one nonsecure callable function in order to build (Remove this if it is not required to build). */
BSP_CMSE_NONSECURE_ENTRY void template_nonsecure_callable ()
{

}
FSP_CPP_FOOTER

#endif
